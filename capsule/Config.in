## gadget/Config.in
```kconfig
source "$BR2_EXTERNAL_GADGETOS_PATH/package/demo-blinkenlights/Config.in"
source "$BR2_EXTERNAL_GADGETOS_PATH/package/demo-vu-meter/Config.in"
source "$BR2_EXTERNAL_GADGETOS_PATH/package/gadget-bluetooth-conf/Config.in"
source "$BR2_EXTERNAL_GADGETOS_PATH/package/gadget-initc/Config.in"
source "$BR2_EXTERNAL_GADGETOS_PATH/package/gadget-init-scripts/Config.in"
source "$BR2_EXTERNAL_GADGETOS_PATH/package/gadget-setup-ssh-key/Config.in"
source "$BR2_EXTERNAL_GADGETOS_PATH/package/gadget-tools/Config.in"
source "$BR2_EXTERNAL_GADGETOS_PATH/package/dtc-overlay/Config.in.host"
source "$BR2_EXTERNAL_GADGETOS_PATH/package/rtl8723bs_mp_driver/Config.in"
source "$BR2_EXTERNAL_GADGETOS_PATH/package/rtl8723ds_mp_driver/Config.in"
source "$BR2_EXTERNAL_GADGETOS_PATH/package/rtl8723ds_bt/Config.in"
source "$BR2_EXTERNAL_GADGETOS_PATH/package/python-chip-io/Config.in"
source "$BR2_EXTERNAL_GADGETOS_PATH/package/eth_usb_gadget/Config.in"
source "$BR2_EXTERNAL_GADGETOS_PATH/package/network-interfaces-script/Config.in.host"
source "$BR2_EXTERNAL_GADGETOS_PATH/package/chip-mtd-utils/Config.in"
source "$BR2_EXTERNAL_GADGETOS_PATH/package/chip-mtd-utils/Config.in.host"
source "$BR2_EXTERNAL_GADGETOS_PATH/package/mender/Config.in"
source "$BR2_EXTERNAL_GADGETOS_PATH/package/gadget-update/Config.in"
source "$BR2_EXTERNAL_GADGETOS_PATH/package/chip-nand-scripts/Config.in.host"
source "$BR2_EXTERNAL_GADGETOS_PATH/package/wifi-onboarding/Config.in"
```

## gadget/configs/chip_docker_defconfig
```kconfig
BR2_arm=y
BR2_cortex_a8=y
BR2_ARM_INSTRUCTIONS_THUMB2=y
BR2_DL_DIR="/opt/dlcache"
BR2_BACKUP_SITE="http://sources.buildroot.net/"
BR2_KERNEL_MIRROR="http://www.kernel.org/pub/"
BR2_LUAROCKS_MIRROR="http://luarocks.org/repositories/rocks"
BR2_CPAN_MIRROR="http://search.cpan.org/CPAN"
BR2_PACKAGE_OVERRIDE_FILE="$(TOPDIR)/local.mk"
BR2_TOOLCHAIN_EXTERNAL=y
BR2_TARGET_OPTIMIZATION="-pipe"
BR2_TARGET_GENERIC_HOSTNAME="chip"
BR2_TARGET_GENERIC_ROOT_PASSWD="root"
# BR2_TARGET_GENERIC_GETTY is not set
BR2_ROOTFS_USERS_TABLES="${BR2_EXTERNAL_GADGETOS_PATH}/board/nextthing/chippro/users_table.txt"
BR2_ROOTFS_OVERLAY="${BR2_EXTERNAL_GADGETOS_PATH}/board/nextthing/chippro/overlay"
BR2_ROOTFS_POST_BUILD_SCRIPT="${BR2_EXTERNAL_GADGETOS_PATH}/board/nextthing/chippro/scripts/post-build.sh"
BR2_ROOTFS_POST_IMAGE_SCRIPT="${BR2_EXTERNAL_GADGETOS_PATH}/board/nextthing/chippro/scripts/post-image.sh"
BR2_ROOTFS_POST_SCRIPT_ARGS="\"Hynix-MLC\""
BR2_LINUX_KERNEL=y
BR2_LINUX_KERNEL_CUSTOM_GIT=y
BR2_LINUX_KERNEL_CUSTOM_REPO_URL="https://github.com/NextThingCo/CHIP-linux.git"
BR2_LINUX_KERNEL_CUSTOM_REPO_VERSION="debian/4.4.13-ntc-mlc"
BR2_LINUX_KERNEL_PATCH="${BR2_EXTERNAL_GADGETOS_PATH}/board/nextthing/chip/patches/linux/"
BR2_LINUX_KERNEL_USE_CUSTOM_CONFIG=y
BR2_LINUX_KERNEL_CUSTOM_CONFIG_FILE="${BR2_EXTERNAL_GADGETOS_PATH}/board/nextthing/chip/configs/linux.config"
BR2_LINUX_KERNEL_LZO=y
BR2_LINUX_KERNEL_DTS_SUPPORT=y
BR2_LINUX_KERNEL_INTREE_DTS_NAME="sun5i-r8-chip"
BR2_PACKAGE_BUSYBOX_CONFIG="${BR2_EXTERNAL_GADGETOS_PATH}/board/nextthing/chippro/configs/busybox.config"
BR2_PACKAGE_BUSYBOX_SHOW_OTHERS=y
BR2_PACKAGE_ALSA_UTILS=y
BR2_PACKAGE_ALSA_UTILS_AMIXER=y
BR2_PACKAGE_MTD=y
BR2_PACKAGE_UBOOT_TOOLS=y
BR2_PACKAGE_PYTHON=y
# BR2_PACKAGE_PYTHON_UNICODEDATA is not set
BR2_PACKAGE_PYTHON_ALSAAUDIO=y
# BR2_PACKAGE_ALSA_LIB_RAWMIDI is not set
# BR2_PACKAGE_ALSA_LIB_ALISP is not set
BR2_PACKAGE_CA_CERTIFICATES=y
BR2_PACKAGE_OPENSSL=y
BR2_PACKAGE_BIND=y
# BR2_PACKAGE_BIND_SERVER is not set
BR2_PACKAGE_BIND_TOOLS=y
BR2_PACKAGE_CONNMAN=y
# BR2_PACKAGE_CONNMAN_ETHERNET is not set
BR2_PACKAGE_CONNMAN_WIFI=y
BR2_PACKAGE_CONNMAN_BLUETOOTH=y
BR2_PACKAGE_CONNMAN_LOOPBACK=y
BR2_PACKAGE_CONNMAN_CLIENT=y
BR2_PACKAGE_DHCPCD=y
BR2_PACKAGE_DNSMASQ=y
# BR2_PACKAGE_DNSMASQ_TFTP is not set
BR2_PACKAGE_IPROUTE2=y
BR2_PACKAGE_IW=y
BR2_PACKAGE_WPA_SUPPLICANT_AP_SUPPORT=y
BR2_PACKAGE_WPA_SUPPLICANT_EAP=y
BR2_PACKAGE_WPA_SUPPLICANT_HOTSPOT=y
BR2_PACKAGE_WPA_SUPPLICANT_CLI=y
BR2_PACKAGE_WPA_SUPPLICANT_PASSPHRASE=y
BR2_PACKAGE_WPA_SUPPLICANT_DBUS_INTROSPECTION=y
BR2_PACKAGE_CGROUPFS_MOUNT=y
BR2_PACKAGE_DOCKER_ENGINE=y
BR2_PACKAGE_DOCKER_ENGINE_DRIVER_DEVICEMAPPER=y
# BR2_TARGET_ROOTFS_TAR is not set
BR2_TARGET_ROOTFS_UBIFS=y
BR2_TARGET_ROOTFS_UBIFS_LEBSIZE=0x1f8000
BR2_TARGET_ROOTFS_UBIFS_MINIOSIZE=0x4000
BR2_TARGET_ROOTFS_UBIFS_MAXLEBCNT=2000
BR2_TARGET_ROOTFS_UBIFS_LZO=y
BR2_TARGET_ROOTFS_UBI=y
BR2_TARGET_ROOTFS_UBI_PEBSIZE=0x400000
BR2_TARGET_ROOTFS_UBI_SUBSIZE=16384
BR2_TARGET_ROOTFS_UBI_USE_CUSTOM_CONFIG=y
BR2_TARGET_ROOTFS_UBI_CUSTOM_CONFIG_FILE="${BR2_EXTERNAL_GADGETOS_PATH}/board/nextthing/chip/configs/ubinize.config"
BR2_TARGET_ROOTFS_UBI_OPTS="-M dist3"
BR2_TARGET_UBOOT=y
BR2_TARGET_UBOOT_BUILD_SYSTEM_KCONFIG=y
BR2_TARGET_UBOOT_CUSTOM_GIT=y
BR2_TARGET_UBOOT_CUSTOM_REPO_URL="https://github.com/nextthingco/chip-u-boot"
BR2_TARGET_UBOOT_CUSTOM_REPO_VERSION="ww/2016.01/next-mlc"
BR2_TARGET_UBOOT_BOARD_DEFCONFIG="chippro"
BR2_TARGET_UBOOT_FORMAT_CUSTOM=y
BR2_TARGET_UBOOT_FORMAT_CUSTOM_NAME="u-boot-dtb.bin"
BR2_TARGET_UBOOT_SPL=y
BR2_TARGET_UBOOT_SPL_NAME="u-boot-sunxi-with-spl.bin spl/sunxi-spl.bin spl/sunxi-spl-with-ecc.bin"
BR2_TARGET_UBOOT_ENVIMAGE=y
BR2_TARGET_UBOOT_ENVIMAGE_SOURCE="${BR2_EXTERNAL_GADGETOS_PATH}/board/nextthing/chippro/uboot-env"
BR2_TARGET_UBOOT_ENVIMAGE_SIZE="0x400000"
BR2_PACKAGE_HOST_SUNXI_TOOLS=y
BR2_PACKAGE_HOST_UBOOT_TOOLS=y
BR2_PACKAGE_DEMO_VU_METER=y
BR2_PACKAGE_GADGET_INIT_SCRIPTS=y
BR2_PACKAGE_GADGET_TOOLS=y
BR2_PACKAGE_HOST_DTC_OVERLAY=y
BR2_PACKAGE_RTL8723BS_MP_DRIVER=y
BR2_PACKAGE_RTL8723DS_MP_DRIVER=y
BR2_PACKAGE_PYTHON_CHIP_IO=y
BR2_PACKAGE_HOST_CHIP_MTD_UTILS=y
```

## gadget/configs/chippro_vumeter_defconfig
```kconfig
BR2_arm=y
BR2_cortex_a8=y
BR2_ARM_INSTRUCTIONS_THUMB2=y
BR2_DL_DIR="/opt/dlcache"
BR2_BACKUP_SITE="http://sources.buildroot.net/"
BR2_KERNEL_MIRROR="http://www.kernel.org/pub/"
BR2_LUAROCKS_MIRROR="http://luarocks.org/repositories/rocks"
BR2_CPAN_MIRROR="http://search.cpan.org/CPAN"
BR2_PACKAGE_OVERRIDE_FILE="$(TOPDIR)/local.mk"
BR2_TOOLCHAIN_EXTERNAL=y
BR2_TARGET_OPTIMIZATION="-pipe"
BR2_TARGET_GENERIC_HOSTNAME="chip"
BR2_TARGET_GENERIC_ROOT_PASSWD="root"
# BR2_TARGET_GENERIC_GETTY is not set
BR2_ROOTFS_USERS_TABLES="${BR2_EXTERNAL_GADGETOS_PATH}/board/nextthing/chippro/users_table.txt"
BR2_ROOTFS_OVERLAY="${BR2_EXTERNAL_GADGETOS_PATH}/board/nextthing/chippro/overlay"
BR2_ROOTFS_POST_BUILD_SCRIPT="${BR2_EXTERNAL_GADGETOS_PATH}/board/nextthing/chippro/scripts/post-build.sh"
BR2_ROOTFS_POST_IMAGE_SCRIPT="${BR2_EXTERNAL_GADGETOS_PATH}/board/nextthing/chippro/scripts/post-image.sh"
BR2_ROOTFS_POST_SCRIPT_ARGS="\"Toshiba-SLC-4G-TC58NVG2S0H\""
BR2_LINUX_KERNEL=y
BR2_LINUX_KERNEL_CUSTOM_GIT=y
BR2_LINUX_KERNEL_CUSTOM_REPO_URL="https://github.com/NextThingCo/CHIP-linux.git"
BR2_LINUX_KERNEL_CUSTOM_REPO_VERSION="nextthing/4.4/chip"
BR2_LINUX_KERNEL_PATCH="${BR2_EXTERNAL_GADGETOS_PATH}/board/nextthing/chippro/patches/linux/"
BR2_LINUX_KERNEL_USE_CUSTOM_CONFIG=y
BR2_LINUX_KERNEL_CUSTOM_CONFIG_FILE="${BR2_EXTERNAL_GADGETOS_PATH}/board/nextthing/chippro/configs/linux-new.config"
BR2_LINUX_KERNEL_LZO=y
BR2_LINUX_KERNEL_DTS_SUPPORT=y
BR2_LINUX_KERNEL_INTREE_DTS_NAME="ntc-gr8-crumb"
BR2_PACKAGE_BUSYBOX_CONFIG="${BR2_EXTERNAL_GADGETOS_PATH}/board/nextthing/chippro/configs/busybox.config"
BR2_PACKAGE_ALSA_UTILS=y
BR2_PACKAGE_ALSA_UTILS_AMIXER=y
BR2_PACKAGE_UBOOT_TOOLS=y
BR2_PACKAGE_PYTHON=y
# BR2_PACKAGE_PYTHON_UNICODEDATA is not set
BR2_PACKAGE_PYTHON_ALSAAUDIO=y
# BR2_PACKAGE_ALSA_LIB_RAWMIDI is not set
# BR2_PACKAGE_ALSA_LIB_ALISP is not set
BR2_PACKAGE_CA_CERTIFICATES=y
BR2_PACKAGE_OPENSSL=y
BR2_PACKAGE_BIND=y
# BR2_PACKAGE_BIND_SERVER is not set
BR2_PACKAGE_BIND_TOOLS=y
BR2_PACKAGE_CONNMAN=y
# BR2_PACKAGE_CONNMAN_ETHERNET is not set
BR2_PACKAGE_CONNMAN_WIFI=y
BR2_PACKAGE_CONNMAN_BLUETOOTH=y
BR2_PACKAGE_CONNMAN_LOOPBACK=y
BR2_PACKAGE_CONNMAN_CLIENT=y
BR2_PACKAGE_DHCPCD=y
BR2_PACKAGE_DNSMASQ=y
# BR2_PACKAGE_DNSMASQ_TFTP is not set
BR2_PACKAGE_IPROUTE2=y
BR2_PACKAGE_IW=y
BR2_PACKAGE_WPA_SUPPLICANT_AP_SUPPORT=y
BR2_PACKAGE_WPA_SUPPLICANT_EAP=y
BR2_PACKAGE_WPA_SUPPLICANT_HOTSPOT=y
BR2_PACKAGE_WPA_SUPPLICANT_CLI=y
BR2_PACKAGE_WPA_SUPPLICANT_PASSPHRASE=y
BR2_PACKAGE_WPA_SUPPLICANT_DBUS_INTROSPECTION=y
# BR2_TARGET_ROOTFS_TAR is not set
BR2_TARGET_ROOTFS_UBIFS=y
BR2_TARGET_ROOTFS_UBIFS_LEBSIZE=0x3f000
BR2_TARGET_ROOTFS_UBIFS_MINIOSIZE=0x1000
BR2_TARGET_ROOTFS_UBIFS_MAXLEBCNT=2000
BR2_TARGET_ROOTFS_UBIFS_LZO=y
BR2_TARGET_ROOTFS_UBIFS_OPTS="-j 774144"
BR2_TARGET_ROOTFS_UBI=y
BR2_TARGET_ROOTFS_UBI_PEBSIZE=0x40000
BR2_TARGET_ROOTFS_UBI_SUBSIZE=1024
BR2_TARGET_ROOTFS_UBI_USE_CUSTOM_CONFIG=y
BR2_TARGET_ROOTFS_UBI_CUSTOM_CONFIG_FILE="${BR2_EXTERNAL_GADGETOS_PATH}/board/nextthing/chippro/configs/ubinize.config"
BR2_TARGET_UBOOT=y
BR2_TARGET_UBOOT_BUILD_SYSTEM_KCONFIG=y
BR2_TARGET_UBOOT_CUSTOM_GIT=y
BR2_TARGET_UBOOT_CUSTOM_REPO_URL="https://github.com/nextthingco/chip-u-boot"
BR2_TARGET_UBOOT_CUSTOM_REPO_VERSION="ww/2016.01/next"
BR2_TARGET_UBOOT_BOARD_DEFCONFIG="chippro"
BR2_TARGET_UBOOT_FORMAT_CUSTOM=y
BR2_TARGET_UBOOT_FORMAT_CUSTOM_NAME="u-boot-dtb.bin"
BR2_TARGET_UBOOT_SPL=y
BR2_TARGET_UBOOT_SPL_NAME="u-boot-sunxi-with-spl.bin spl/sunxi-spl.bin spl/sunxi-spl-with-ecc.bin"
BR2_TARGET_UBOOT_ENVIMAGE=y
BR2_TARGET_UBOOT_ENVIMAGE_SOURCE="${BR2_EXTERNAL_GADGETOS_PATH}/board/nextthing/chippro/uboot-env"
BR2_TARGET_UBOOT_ENVIMAGE_SIZE="0x400000"
BR2_PACKAGE_HOST_SUNXI_TOOLS=y
BR2_PACKAGE_HOST_UBOOT_TOOLS=y
BR2_PACKAGE_DEMO_VU_METER=y
BR2_PACKAGE_GADGET_INIT_SCRIPTS=y
BR2_PACKAGE_GADGET_TOOLS=y
BR2_PACKAGE_HOST_DTC_OVERLAY=y
BR2_PACKAGE_RTL8723BS_MP_DRIVER=y
BR2_PACKAGE_RTL8723DS_MP_DRIVER=y
BR2_PACKAGE_PYTHON_CHIP_IO=y
```

## gadget/package/eth_usb_gadget/Config.in
```kconfig
config BR2_PACKAGE_ETH_USB_GADGET
	bool "eth_usb_gadget"
	select BR2_PACKAGE_SKELETON
	select BR2_PACKAGE_DNSMASQ
	select BR2_PACKAGE_DNSMASQ_DHCP
    select BR2_PACKAGE_HOST_NETWORK_INTERFACES_SCRIPT
	default n
	help
		Requires an ethernet usb gadget to be enabled in the kernel.\
		Sets up /etc/network/interfaces and dnsmasq.
```

## gadget/package/gadget-bluetooth-conf/Config.in
```kconfig
config BR2_PACKAGE_GADGET_BLUETOOTH_CONF
	bool "gadget-bluetooth-conf"
	help
	  This option tells DBUS to allow bluetooth connections
```

## gadget/package/gadget-init-scripts/Config.in
```kconfig
config BR2_PACKAGE_GADGET_INIT_SCRIPTS
	bool "gadget-init-scripts"
	select BR2_PACKAGE_SKELETON
	select BR2_PACKAGE_DNSMASQ
	select BR2_PACKAGE_DNSMASQ_DHCP

if BR2_PACKAGE_GADGET_INIT_SCRIPTS

config BR2_PACKAGE_GADGET_INIT_SCRIPTS_USB_GADGET
	bool "USB Gadget Init"
	select BR2_PACKAGE_SKELETON
	select BR2_PACKAGE_DNSMASQ
	select BR2_PACKAGE_DNSMASQ_DHCP
	help
	  This option enables usb gadget serial and ethernet on boot

if BR2_PACKAGE_DOCKER_ENGINE_DAEMON

config BR2_PACKAGE_GADGET_INIT_SCRIPTS_DOCKERD
	bool "Dockerd init"
	help
	  This option runs dockerd on boot

endif
endif
```

## gadget/package/gadget-initc/Config.in
```kconfig
config BR2_PACKAGE_GADGET_INITC
	bool "gadget-initc"
	depends on BR2_PACKAGE_HOST_GO_ARCH_SUPPORTS
	select BR2_PACKAGE_DOCKER_ENGINE # runtime dependency
	help
	  initializes gadget containers to run on boot

	  https://github.com/nextthingco/gadgetcli
```

## gadget/package/gadget-setup-ssh-key/Config.in
```kconfig
config BR2_PACKAGE_GADGET_SETUP_SSH_KEY
	bool "gadget-setup-ssh-key"
	help
	  The default ssh key used during setup, to be replaced after first use
```

## gadget/package/gadget-update/Config.in
```kconfig
config BR2_PACKAGE_GADGET_UPDATE
	bool "gadget-update"
	select BR2_PACKAGE_JQ
	select BR2_PACKAGE_LIBCURL
	select BR2_PACKAGE_CURL
	select BR2_PACKAGE_MTD
    select BR2_PACKAGE_MTD_UBIUPDATEVOL
```

## gadget/package/gadgetosd/Config.in
```kconfig
config BR2_PACKAGE_GADGETOSD
	bool "GadgetOSd"
	help
	  Build GadgetOsd

    select BR2_PACKAGE_UTIL_LINUX
    select BR2_PACKAGE_UTIL_LINUX_LIBUUID

    select BR2_PACKAGE_MONGOOSE_6_7
    select BR2_PACKAGE_MONGOOSE_6_7_ENABLE_HTTP_STREAMING_MULTIPART
```

## gadget/package/mender/Config.in
```kconfig
config BR2_PACKAGE_MENDER
	bool "mender"
	depends on BR2_PACKAGE_HOST_GO_ARCH_SUPPORTS
	depends on BR2_PACKAGE_HOST_GO_CGO_LINKING_SUPPORTS
	depends on BR2_TOOLCHAIN_HAS_THREADS
	help
	  Mender is an open source over-the-air (OTA) software updater
          for embedded Linux devices.

	  https://github.com/mendersoftware/mender

comment "mender needs a toolchain w/ threads"
	depends on BR2_PACKAGE_HOST_GO_ARCH_SUPPORTS && \
		BR2_PACKAGE_HOST_GO_CGO_LINKING_SUPPORTS
	depends on !BR2_TOOLCHAIN_HAS_THREADS
```

## gadget/package/mongoose-6.7/Config.in
```kconfig
config BR2_PACKAGE_MONGOOSE_6_7
	bool "mongoose-6.7"
	depends on BR2_TOOLCHAIN_HAS_THREADS
	depends on BR2_USE_MMU # fork()
	help
	  Mongoose is an embedded networking library, which can turn
	  anything into a web server

	  https://github.com/cesanta/mongoose

comment "mongoose needs a toolchain w/ threads"
	depends on BR2_USE_MMU
	depends on !BR2_TOOLCHAIN_HAS_THREADS

if BR2_PACKAGE_MONGOOSE_6_7

config BR2_PACKAGE_MONGOOSE_6_7_ENABLE_HTTP_STREAMING_MULTIPART
	bool "mongoose: enable http streaming multipart"

endif
```

## gadget/package/network-interfaces-script/Config.in.host
```kconfig
config BR2_PACKAGE_HOST_NETWORK_INTERFACES_SCRIPT
	bool "host-network-interfaces-script"
	default n
	help
		Helps to setup interfaces in /etc/network/interfaces.
```

## gadget/package/python-chip-io/Config.in
```kconfig
config BR2_PACKAGE_PYTHON_CHIP_IO
	bool "python-chip-io"
	select BR2_PACKAGE_HOST_DTC
```

## gadget/package/rauc/Config.in
```kconfig
config BR2_PACKAGE_RAUC
	bool "rauc"
	select BR2_PACKAGE_LIBGLIB2
	select BR2_PACKAGE_LIBCURL
	select BR2_PACKAGE_OPENSSL
	select BR2_PACKAGE_JSON_GLIB

	help
	RAUC controls the update process on embedded linux systems.
	It is both a target application that runs as an update client
	and a host/target tool that allows you to create, inspect and
	modify installation artifacts.

	  https://github.com/rauc/rauc
```

## gadget/package/wifi-onboarding/Config.in
```kconfig
config BR2_PACKAGE_WIFI_ONBOARDING
	bool "wifi-onboarding"
	depends on BR2_PACKAGE_HOST_GO_ARCH_SUPPORTS
	select BR2_PACKAGE_HOSTAPD
	help
	  Headless Wifi Setup

	  https://github.com/nextthingco/wifi-onboarding

if BR2_PACKAGE_WIFI_ONBOARDING

config BR2_PACKAGE_WIFI_ONBOARDING_DEFAULT_PORT
	string ":[PORT] for wifi-onboarding"
	default ":8080"
	help
	  ':1234' will serve on all interfaces at port 1234. String must
	  include the colon. The server will default to port 8080 if no
	  string is provided.

endif
```
